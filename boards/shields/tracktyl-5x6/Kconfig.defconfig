## boards/shields/tracktyl-5x6/Kconfig.defconfig
```kconfig
if SHIELD_TRACKTYL_5X6_LEFT

    config ZMK_KEYBOARD_NAME
        default "Tracktyl-5x6-L"

endif

if SHIELD_TRACKTYL_5X6_RIGHT

    config ZMK_KEYBOARD_NAME
        default "Tracktyl-5x6-R"

    config ZMK_SPLIT_BLE_ROLE_CENTRAL
        default y

endif

if SHIELD_TRACKTYL_5X6_LEFT || SHIELD_TRACKTYL_5X6_RIGHT

    config ZMK_SPLIT
        default y

endif
```

## boards/shields/tracktyl-5x6/Kconfig.shield
```kconfig
config SHIELD_TRACKTYL_5X6_LEFT
    def_bool $(shields_list_contains,tracktyl-5x6_left)

config SHIELD_TRACKTYL_5X6_RIGHT
    def_bool $(shields_list_contains,tracktyl-5x6_right)
```
